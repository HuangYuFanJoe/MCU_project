#include <stdio.h>																											 
#include "NUC1xx.h"
#include "LCD_Driver.h"
#include "DrvGPIO.h"
#include "DrvPWM.h"
// Smpl_PWM_Tone
// use PWM to generate musical notes
#include "DrvSYS.h"

extern  SPI_T * SPI_PORT[4]={SPI0, SPI3, SPI2, SPI3};
volatile uint8_t old_x=0,old_x2 = 104, locx = 80, locy,t = 0,old_x3 = 32, old_y3 = 1,m,delay,d = 0,locrope = 112,rand = 96,temp,locx3 = 0,
mcatch[3] = {0,5,9},
mstart[55] = {0,12,0,10,11,12,0,10,11,12,5,6,7,8,9,10,11,10,0,8,9,10,3,4,5,6,5,4,5,3,4,5,4,6,5,4,3,2,3,2,1,2,3,4,5,6,4,6,5,6,7,8,5,6,7},i = 0;
int old_y2 = 1,gametime = 0,start = 0,savetime = 0,final = 0,lochero = 0, lockiller = 64, locjj = 88,save = 0;
unsigned int x,y,l,press = 0, press2 = 0, pull = 0, side = 1, score = 0;
static const char startmap1[6][128] = {0x00,0x00,0x00,0x00,0x00,0xF8,0xD8,0x98,0x98,0x00,0x18,0x18,0xF8,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0x00,0x00},
	startmap2[2][128] = {0x00,0x00,0x00,0x00,0x00,0x00,0x00,0x00,0x00,0x00,0x00,0x00,0x00,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0x00,0x00},
	mission1[8][128] = {0x00,0x00,0x00,0x00,0x00,0x00,0x00,0x00,0x00,0x00,0x00,0x00,0x00,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0x00,0x00},
	background1[8][128] = {0xFC,0xFC,0xFE,0xFE,0xF8,0xFE,0xFE,0xFF,0xFF,0xFF,0xFF,0xF7,0xF1,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0x00,0x00},
	killer[4][21] = {0x00,0x30,0xF0,0x3C,0x3C,0xDE,0xDA,0xDE,0x1C,0x98,0xD8,0xF0,0x00,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0x00,0x00},
	umbra[4][17] = {0x00,0x80,0xC0,0xC0,0xC0,0xE0,0xE0,0xE0,0xE0,0xE0,0xE0,0xE0,0xE0,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0x00,0x00},
	run[4][21] = {0x00,0x00,0x38,0x7C,0x7C,0xFC,0xFC,0xB8,0x00,0x00,0x00,0x00,0x00,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0x01,0x01},
	baggage[4][19] = {0x00,0x00,0x00,0x1F,0xFF,0xFF,0xFF,0xDF,0x8E,0x00,0x00,0x00,0x00,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0x1F,0x0E},
	lworker[5][35] = {0x00,0x00,0x00,0x00,0x00,0x00,0x00,0x00,0x00,0x00,0x00,0x00,0x00,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0x03,0x03},
	rworker[5][35] = {0x00,0x00,0x00,0x00,0x00,0x00,0x00,0x00,0xC0,0xC0,0xC0,0xC0,0xC0,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0x07,0x07},
	gameover[8][128] = {0xFF,0xFF,0xFF,0xFF,0xFF,0xFF,0xFF,0xFF,0xFF,0xFF,0xFF,0xFF,0xFF,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0xFF,0xFF},
  pointer[8] = {0xc3,0x81,0x81,0x18,0x18,0x81,0x81,0xc3},
	goodjob[2][128] = {0x00,0x00,0x00,0x00,0x00,0x00,0x00,0x00,0x00,0x00,0x00,0x0C,0x38,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0x00,0x00},
	awesome[2][128] = {0x00,0x00,0x00,0x00,0x00,0x00,0x00,0x00,0x00,0x00,0x00,0x00,0x00,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0x00,0x00},
	mission2[8][128] = {0x00,0x00,0x00,0x00,0x00,0x00,0x00,0x00,0x00,0x00,0x00,0x00,0x00,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0x00,0x00},
	background2[8][128] = {0x00,0x00,0x00,0x00,0x00,0x00,0x00,0x00,0x00,0x00,0x00,0x00,0x00,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0xFF,0xFF},
	rope[8] = {0x00,0x00,0x00,0xff,0xff,0x00,0x00,0x00},
	mission3[8][128] = {0x00,0x00,0x00,0x00,0x00,0x00,0x00,0x00,0x00,0x00,0x00,0x00,0x00,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0x00,0x00},
	ball[8] = {0x3c,0x7e,0xff,0xff,0xff,0xff,0x7e,0x3c},
	biggun[3][26] = {0x80,0x80,0x00,0x00,0xC0,0xE0,0xF0,0x98,0xD8,0xF8,0x18,0xD8,0x70,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0x01,0x03},
	mission4[8][128] = {0x00,0x00,0x00,0x00,0x00,0x00,0x00,0x00,0x00,0x00,0x00,0x00,0x00,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0x00,0x00},
	jjdie[2][34] = {0x10,0x30,0x30,0x30,0x30,0x70,0xF0,0xE0,0xE0,0xE0,0xE0,0xE0,0xC0,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0x01,0x01},
	hero[4][38] = {0x00,0x00,0x00,0x00,0x00,0x30,0x48,0x78,0x38,0xF8,0x78,0x00,0x00,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0x00,0x00},
	heroatt[4][30] = {0x00,0x00,0x00,0x00,0x00,0x80,0x80,0xF0,0xF8,0xF8,0xF8,0xF8,0x70,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0xE0,0xC0},
	hey[2][13] = {0xE0,0x40,0x40,0x40,0xE0,0x00,0xC0,0xC0,0xC0,0x00,0xC0,0x00,0xC0,0x01,0x00,0x00,0x00,0x01,0x00,0x01,0x02,0x02,0x00,0x00,0x03,0x00},
	finish[8][128] = {0x00,0x00,0x00,0x00,0x00,0x00,0x00,0x00,0x00,0x00,0x00,0x00,0x00,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0x00,0x00};
	uint8_t duty_cycle;
void InitTIMER0(void)
{
	/* Step 1. Enable and Select Timer clock source */          
		SYSCLK->CLKSEL1.TMR0_S = 0;	//Select 12Mhz for Timer0 clock source 
    SYSCLK->APBCLK.TMR0_EN =1;	//Enable Timer0 clock source

	/* Step 2. Select Operation mode */	
	TIMER0->TCSR.MODE=1;		//Select periodic mode for operation mode

	/* Step 3. Select Time out period = (Period of timer clock input) * (8-bit Prescale + 1) * (24-bit TCMP)*/
	TIMER0->TCSR.PRESCALE=255;	// Set Prescale [0~255]
	TIMER0->TCMPR = 36000;		// Set TCMPR [0~16777215]
								// (1/12000000)*(255+1)*(27650)= 0.58 sec 

	/* Step 4. Enable interrupt */
	TIMER0->TCSR.IE = 1;
	NVIC_EnableIRQ(TMR0_IRQn);	//Enable Timer0 Interrupt

	/* Step 5. Enable Timer module */
	TIMER0->TCSR.CRST = 1;		//Reset up counter
	TIMER0->TCSR.CEN = 1;		//Enable Timer0

//  	TIMER0->TCSR.TDR_EN=1;		// Enable TDR function
}

void InitTIMER1(void)
{
	/* Step 1. Enable and Select Timer clock source */          
		SYSCLK->CLKSEL1.TMR1_S = 0;	//Select 12Mhz for Timer0 clock source 
    SYSCLK->APBCLK.TMR1_EN =1;	//Enable Timer0 clock source

	/* Step 2. Select Operation mode */	
	TIMER1->TCSR.MODE=1;		//Select periodic mode for operation mode

	/* Step 3. Select Time out period = (Period of timer clock input) * (8-bit Prescale + 1) * (24-bit TCMP)*/
	TIMER1->TCSR.PRESCALE=100;	// Set Prescale [0~255]
	TIMER1->TCMPR = 30000;		// Set TCMPR [0~16777215]
								// (1/12000000)*(255+1)*(20000)= 0.426 sec 

	/* Step 4. Enable interrupt */
	TIMER1->TCSR.IE = 1;
	NVIC_EnableIRQ(TMR1_IRQn);	//Enable Timer0 Interrupt

	/* Step 5. Enable Timer module */
	TIMER1->TCSR.CRST = 1;		//Reset up counter
	TIMER1->TCSR.CEN = 1;		//Enable Timer0

//  	TIMER0->TCSR.TDR_EN=1;		// Enable TDR function
}

void InitTIMER2(void)
{
	
	/* Step 1. Enable and Select Timer clock source */          
		SYSCLK->CLKSEL1.TMR2_S = 0;	//Select 12Mhz for Timer2 clock source 
    SYSCLK->APBCLK.TMR2_EN =1;	//Enable Timer2 clock source

	/* Step 2. Select Operation mode */	
	TIMER2->TCSR.MODE=1;		//Select periodic mode for operation mode

	/* Step 3. Select Time out period = (Period of timer clock input) * (8-bit Prescale + 1) * (24-bit TCMP)*/
	TIMER2->TCSR.PRESCALE=255;	// Set Prescale [0~255]
	TIMER2->TCMPR = 27650;		// Set TCMPR [0~16777215]
								// (1/12000000)*(255+1)*(27650)= 0.58 sec 

	/* Step 4. Enable interrupt */
	TIMER2->TCSR.IE = 1;
	NVIC_EnableIRQ(TMR2_IRQn);	//Enable Timer2 Interrupt

	/* Step 5. Enable Timer module */
	TIMER2->TCSR.CRST = 1;		//Reset up counter
	TIMER2->TCSR.CEN = 1;		//Enable Timer0

//  	TIMER2->TCSR.TDR_EN=1;		// Enable TDR function
}

void InitTIMER3(void)
{
	/* Step 1. Enable and Select Timer clock source */          
		SYSCLK->CLKSEL1.TMR3_S = 0;	//Select 12Mhz for Timer0 clock source 
    SYSCLK->APBCLK.TMR3_EN =1;	//Enable Timer0 clock source

	/* Step 2. Select Operation mode */	
	TIMER3->TCSR.MODE=1;		//Select periodic mode for operation mode

	/* Step 3. Select Time out period = (Period of timer clock input) * (8-bit Prescale + 1) * (24-bit TCMP)*/
	TIMER3->TCSR.PRESCALE=255;	// Set Prescale [0~255]
	TIMER3->TCMPR = 27650;		// Set TCMPR [0~16777215]
								// (1/12000000)*(255+1)*(27650)= 0.58 sec 

	/* Step 4. Enable interrupt */
	TIMER3->TCSR.IE = 1;
	NVIC_EnableIRQ(TMR3_IRQn);	//Enable Timer0 Interrupt

	/* Step 5. Enable Timer module */
	TIMER3->TCSR.CRST = 1;		//Reset up counter
	TIMER3->TCSR.CEN = 1;		//Enable Timer0

//  	TIMER0->TCSR.TDR_EN=1;		// Enable TDR function
}

void Initial_Lcd()
{
		uint8_t x, y;
		SYSCLK->APBCLK.SPI3_EN  =1;			 //enable spi function 
		SYS->IPRSTC2.SPI3_RST   =1;			 //reset spi function
		SYS->IPRSTC2.SPI3_RST   =0;

		/* set GPIO to SPI mode*/
		SYS->GPDMFP.SPI3_SS0 	=1;
		SYS->GPDMFP.SPI3_CLK 	=1;
		//SYS->GPDMFP.SPI3_MISO0 	=1;
		SYS->GPDMFP.SPI3_MOSI0 	=1;

		SPI_PORT[3]->CNTRL.CLKP = 1;							//CLKP HIGH IDLE
		SPI_PORT[3]->CNTRL.TX_BIT_LEN = 9;						//TX LEGTH 9
		SPI_PORT[3]->CNTRL.TX_NEG = 1;							//SET TX_NEG
		SPI_PORT[3]->DIVIDER.DIVIDER=0X03;					    //SET DIV

		SPI_PORT[3]->SSR.SSR=1;									//ENABLE SLAVE SELECT
		// Set BR
		SPI_PORT[3]->TX[0] =0xEB;
		SPI_PORT[3]->CNTRL.GO_BUSY = 1;
			while ( SPI_PORT[3]->CNTRL.GO_BUSY == 1 );
		// Set PM
		SPI_PORT[3]->SSR.SSR=0;

		SPI_PORT[3]->SSR.SSR=1;
		//outp32(SPI3_Tx0, 0x81);	
		SPI_PORT[3]->TX[0] =0x81;
		SPI_PORT[3]->CNTRL.GO_BUSY = 1;
			while ( SPI_PORT[3]->CNTRL.GO_BUSY == 1 );
		SPI_PORT[3]->TX[0] =0xa0;
		SPI_PORT[3]->CNTRL.GO_BUSY = 1;
			while ( SPI_PORT[3]->CNTRL.GO_BUSY == 1 );
		SPI_PORT[3]->SSR.SSR=0;

		SPI_PORT[3]->SSR.SSR=1;
		//outp32(SPI3_Tx0, 0xC0);
		SPI_PORT[3]->TX[0] =0xc0;	
		SPI_PORT[3]->CNTRL.GO_BUSY = 1;
			while ( SPI_PORT[3]->CNTRL.GO_BUSY == 1 );
		// Set Display Enable
		SPI_PORT[3]->SSR.SSR=0;

		SPI_PORT[3]->SSR.SSR=1;
		SPI_PORT[3]->TX[0] = 0XAF;
		SPI_PORT[3]->CNTRL.GO_BUSY = 1;
			while ( SPI_PORT[3]->CNTRL.GO_BUSY == 1 );
		for (y=0; y< 128; y++) 
		{
			for (x=0; x< 8; x++) 
			{
					SPI_PORT[3]->TX[0] = 0xB0 | x;	
					SPI_PORT[3]->CNTRL.GO_BUSY = 1;
						while ( SPI_PORT[3]->CNTRL.GO_BUSY == 1 );	 //check data out?

						
					//cloumn MSB
					SPI_PORT[3]->TX[0] =0x10 |((129-y)>>4)&0xF;
					SPI_PORT[3]->CNTRL.GO_BUSY = 1;
						while ( SPI_PORT[3]->CNTRL.GO_BUSY == 1 );	  //check data out?
							
							
					// cloumn LSB
					SPI_PORT[3]->TX[0] =0x00 | ((129-y) & 0xF);		
					SPI_PORT[3]->CNTRL.GO_BUSY = 1;
						while ( SPI_PORT[3]->CNTRL.GO_BUSY == 1 );	  //check data out?
							
					// Write Data
					//SPI_PORT[3]->SSR.SSR=1;	   //chip select
					SPI_PORT[3]->TX[0] =0x100 | 0;    	//write data
					SPI_PORT[3]->CNTRL.GO_BUSY = 1;
						while ( SPI_PORT[3]->CNTRL.GO_BUSY == 1 ); //check data out?
			}
		}
}

void draw(uint8_t x,uint8_t y,unsigned char data)
{
			SPI_PORT[3]->TX[0] = 0xB0 | x;	
			SPI_PORT[3]->CNTRL.GO_BUSY = 1;
				while ( SPI_PORT[3]->CNTRL.GO_BUSY == 1 );	 //check data out?

				
			//cloumn MSB
			SPI_PORT[3]->TX[0] =0x10 |((129-y)>>4)&0xF;
			SPI_PORT[3]->CNTRL.GO_BUSY = 1;
				while ( SPI_PORT[3]->CNTRL.GO_BUSY == 1 );	  //check data out?
					
					
			// cloumn LSB
			SPI_PORT[3]->TX[0] =0x00 | ((129-y) & 0xF);		
			SPI_PORT[3]->CNTRL.GO_BUSY = 1;
				while ( SPI_PORT[3]->CNTRL.GO_BUSY == 1 );	  //check data out?
					
			// Write Data
			SPI_PORT[3]->TX[0] =0x100 | data;    	//write data
			SPI_PORT[3]->CNTRL.GO_BUSY = 1;
				while ( SPI_PORT[3]->CNTRL.GO_BUSY == 1 ); //check data out?
}

//=====================================================================================
void InitPWM(void)
{
//-------------------------------------------------------------------------------------
 	// Step 1. GPIO initial, 

	SYS->GPBMFP.TM3_PWM4=1; 	//set GPB_MFP11 for PWM4
	SYS->ALTMFP.PB11_PWM4=1; 	//set PB11_PWM4 for PWM4
	
	
				
//-------------------------------------------------------------------------------------
	// Step 2. Enable and Select PWM clock source

	//-------------------------------------------------------
	SYSCLK->APBCLK.PWM45_EN = 1; //Enable PWM4 & PWM5 clock
	
	//-------------------------------------------------------
	//PWM0 and PWM1 clock source select
	//00=external, 01=32.768k, 10=HCLK, 11=22.1184M
	
	SYSCLK->CLKSEL2.PWM45_S = 0; //Select 12Mhz for PWM clock source

	//-------------------------------------------------------
	//Clock input is divided by (CP + 1)

	PWMB->PPR.CP01=1;		//PWM45	
	
	//-------------------------------------------------------
	// PWM clock = clock source/(Prescaler + 1)/divider
	//PWM Timer 0 Clock Source Divider 
	//000=2, 001=4, 010=8, 011=16, 100=1
	
	PWMB->CSR.CSR0=0;		//PWM4	
				         
//-------------------------------------------------------------------------------------
	
	//PWM-Timer 0 Auto-reload/One-Shot Mode 
	//CNR and CMR will be auto-cleared after setting CH0MOD form 0 to 1.
	//0:One-shot mode, 1:Auto-load mode

	PWMB->PCR.CH0MOD=1;	//PWM4
								
	//-------------------------------------------------------
	//PWM frequency = PWMxy_CLK/[(prescale+1)*(clock divider)*(CNR+1)];
	//Duty ratio = (CMR+1)/(CNR+1).
	//CMR >= CNR: PWM output is always high.
	//CMR < CNR: PWM low width = (CNR-CMR) unit; PWM high width = (CMR+1) unit.
	//CMR = 0: PWM low width = (CNR) unit; PWM high width = 1 unit
	
	PWMB->CNR0=0xFFFF; //PWM4
	
	//-------------------------------------------------------
	//CMR determin the PWM duty

	PWMB->CMR0=0xFFFF; 	//PWM4


	//-------------------------------------------------------
	//PWM-Timer 0 Output Inverter Enable
	//Inverter->0:off, 1:on
	
	PWMB->PCR.CH0INV=0;			//PWM4 
	
	//-------------------------------------------------------
	//PWM-Timer 0 Enable (PWM timer 0 for group A and PWM timer 4 for group B
	//PWM function->0:Disable, 1:Enable
	
	PWMB->PCR.CH0EN=1;	//PWM4			
	//-------------------------------------------------------
	// Enable PWM channel 0 output to pin
	//Output to pin->0:Diasble, 1:Enable
	

	PWMB->POE.PWM0=1;	//PWM4			
	
}


//=====================================================================================
void PWM4_Freq(uint32_t PWM_frequency, uint8_t PWM_duty)
{
	uint8_t  PWM_PreScaler;
	uint16_t PWM_ClockDivider;
	uint16_t CNR0, CMR0;
	uint32_t PWM_Clock;

 	if (PWM_frequency == 0) 
		PWMB->POE.PWM0=0;
	else
	{		
		PWMB->POE.PWM0=1;
		// PWM setting
		if(	SYSCLK->CLKSEL2.PWM45_S == 0)/*外部clock*/
			PWM_Clock = 12000000; // Clock source = 12 MHz
		if(	SYSCLK->CLKSEL2.PWM45_S == 3)/*內部clock*/
			PWM_Clock = 22118400; // Clock source = 22.1184MHz
		
		PWM_PreScaler = 20;    // clock is divided by (PreScaler + 1)

		PWM_ClockDivider = 2;  // 0: 1/2, 1: 1/4, 2: 1/8, 3: 1/16, 4: 1

    //PWM_Freq = PWM_Clock / (PWM_PreScaler + 1) / PWM_ClockDivider / (PWM_CNR0 + 1); 
		CNR0 = PWM_Clock / PWM_frequency / (PWM_PreScaler + 1) / PWM_ClockDivider - 1;

		// Duty Cycle = (CMR0+1) / (CNR0+1)
		CMR0 = (CNR0 +1) * PWM_duty /100  - 1;

		//PWM setting	  
		PWMB->CSR.CSR0 = 4;                // 0: 1/2, 1: 1/4, 2: 1/8, 3: 1/16, 4: 1
		PWMB->PPR.CP01 = PWM_PreScaler;    // set PreScaler
		PWMB->CNR0 = CNR0;	 			   // set CNR0
		PWMB->CMR0 = CMR0;				   // set CMR0
	}
}

//=====================================================================================
uint32_t Tone_Freq(uint8_t note)
{
	uint32_t note_frequency;
  switch (note) {
    case 0: note_frequency =   0; break;
		case 1: note_frequency = 523; break;
		case 2: note_frequency = 587; break;
		case 3: note_frequency = 659; break;
    case 4: note_frequency = 698; break;
		case 5: note_frequency = 784; break;
		case 6: note_frequency = 880; break;	
    case 7: note_frequency = 988; break;
    case 8: note_frequency = 1046; break;
		case 9: note_frequency = 1175; break;
		case 10: note_frequency = 1318; break;
    case 11: note_frequency = 1397; break;
		case 12: note_frequency = 1568; break;
		case 13: note_frequency = 1760; break;	
    case 14: note_frequency = 1976; break;
    default: note_frequency =   0; break;
	}
	return note_frequency;
}
//=====================================================================================
//	Initial 12M and set HCLK
//=====================================================================================
void InitHCLK12M(void)
{
	UNLOCKREG();

	//External 4~24 MHz High Speed Crystal Enable (write-protection bit)
	SYSCLK->PWRCON.XTL12M_EN = 1;//1 = Enable external 12 MHz

	//HCLK clock source select (write-protection bits)
	SYSCLK->CLKSEL0.HCLK_S = 0;//000 = Clock source from external 12 MHz

	LOCKREG();
	
}

void TMR0_IRQHandler() // Timer0 interrupt subroutine 
{   
	if(press)
		old_x = (old_x + 8)%128;
	if(press2 && pull == 0){
		old_x2 = (old_x2 - 8)%128;
		if(old_x2 < 40){
			if(old_y2 < 7)
				old_y2++;
		}
	}
	if(pull)
			old_y2--;
	if(delay)
			d++;
	else
			d = 0;
	  TIMER0->TISR.TIF =1;
}
void drawgameover(void)
{
	for(y = 0; y < 8; y++)
		for(x = 0; x < 128; x++)
			draw(y,x,gameover[y][x]);
	exit(1);
}
void drawfinal(void)
{
	for(y = 0; y < 8; y++)
		for(x = 0; x < 128; x++)
			draw(y,x,finish[y][x]);
	exit(1);
}
void drawsavepeople(int z)
{
	for(y = z; y < 4; y++)
		for(x = locrope; x < locrope + 21; x++){
			draw(y-z,x,run[y][x-locrope]);
		}
	DrvSYS_Delay(100000);
}
void clearsavepeople(int f)
{
	for(x = locrope; x < locrope + 21; x++)
		draw(f,x,0x00);
}
void TMR1_IRQHandler() // Timer1 interrupt subroutine 
{
    if (m == 1){
			   PWM4_Freq(Tone_Freq(mstart[(i++)%55]),duty_cycle); // set PWM0 with frequency & duty cycle
			   if (i%55 == 54){
			       m = 0;
				     PWM4_Freq(0,duty_cycle); // set PWM0 with frequency & duty cycle
				 }
			}
			else if (m == 2){
				 PWM4_Freq(Tone_Freq(mcatch[(i++)%3]),duty_cycle); // set PWM0 with frequency & duty cycle
				 if (i%3 == 2){
			       m = 0;
				     PWM4_Freq(0,duty_cycle); // set PWM0 with frequency & duty cycle
				 }
			}
			else{
				PWM4_Freq(0,duty_cycle); // set PWM0 with frequency & duty cycle
			}
		TIMER1->TISR.TIF =1;
}
void TMR2_IRQHandler() // Timer1 interrupt subroutine 
{
		old_y3++;
		if(old_y3 == 8)
			old_y3 = 1;
		if(start)
			gametime++;
		if(final)
			savetime++;
	TIMER2->TISR.TIF =1;
}
void TMR3_IRQHandler() // Timer1 interrupt subroutine 
{
	rand = (rand+8)%128;
	TIMER3->TISR.TIF =1;
}
//=====================================================================================
//  MAIN function
//=====================================================================================
int32_t main (void)
{
	GPIO_T * tGPIO_A, *tGPIO_C, *tGPIO_E, *tGPIO_G;	
	uint16_t act[3]={0xfffb,0xfffd,0xfffe}; 		//鍵盤: 指定第一行 第二行 第三行掃描
	uint16_t seg[4] = {0xff80,0xff40,0xff20,0xef10}, changeled[4] = {0x8000,0x4000,0x2000,0x1000}; // 亮哪個燈
	uint16_t pattern[10] = {0x82, 0xee,0x07, 0x46, 0x6a, 0x52, 0x12, 0xe2, 0x02, 0x42}; // 7段顯示器形狀
  uint32_t u32Reg;
	uint32_t u32Reg_temp;
	tGPIO_A = (GPIO_T *)((uint32_t)GPIOA + (0*0x40));
	tGPIO_C = (GPIO_T *)((uint32_t)GPIOA + (2*0x40));
	tGPIO_E = (GPIO_T *)((uint32_t)GPIOA + (4*0x40));
	tGPIO_G = (GPIO_T *)((uint32_t)GPIOA + (6*0x40));
	
	u32Reg = (uint32_t)&GPIOA->PIN + (0*0x40);	//讀取暫存器時須用PIN欄位 
                                                         		
	duty_cycle = 90; // Duty = 50%

	//Initial 12M and set HCLK=12MHz
	InitHCLK12M();
	InitTIMER0();
	InitTIMER1();
	InitTIMER2();
	InitTIMER3();
	Initial_Lcd();
  UNLOCKREG();
	SYSCLK->PWRCON.XTL12M_EN = 1;//啟動12MHZ的時脈計數器
	LOCKREG();
 
	// initialize PWM0, output pin = GPA12
	InitPWM(); 		
	
	while(1)
	{		
			m = 1;
			for(y = 0; y < 6; y++)
				for(x = 0; x < 128; x++)
					draw(y,x,startmap1[y][x]);
			
			if((l++)%30 <= 15){
				for(y = 6; y < 8; y++)
					for(x = 0; x < 128; x++)
						draw(y,x,startmap2[y-6][x]);
			}
			else{
				for(y = 6; y < 8; y++)
					for(x = 0; x < 128; x++)
						draw(y,x,0x00);
			}
		  tGPIO_A->DOUT = act[1];	// 掃描第一行   
			u32Reg_temp=inpw(u32Reg); 	// 用inpw讀取暫存器內容
			if((u32Reg_temp & 0x10) == 0)	 //檢查第一個鍵是否觸發 bit 3 若是 往左一個燈號
			{  
				press = 1;
				m = 0;
				delay = 1;
				while(d < 8){
					for(y = 0; y < 8; y++)
						for(x = 0; x < 128; x++)
							draw(y,x,mission1[y][x]);
				}
				delay = 0;
				for(y = 0; y < 8; y++)
						for(x = 0; x < 128; x++)
							draw(y,x,0x00);
				while(1){ // 任務1				
					for(y = 0; y < 8; y++)
						for(x = 0; x < 128; x++)
							draw(y,x,background1[y][x]);
					
					if(old_x < 104){ 
						for(y = 4; y < 8; y++)
							for(x = old_x + 16; x < old_x + 33; x++){
									draw(y,x,umbra[y-4][x-(old_x+16)]);
							}
						for(x = locx; x < locx + 8; x++) //指標的位置
							draw(5, x, pointer[x-locx]);
						for(x = 0; x < 20; x++){
						  tGPIO_C->DOUT = 0xffff;
						  tGPIO_C->DOUT =  seg[3];
					  	DrvSYS_Delay(500);
					  }
						tGPIO_A->DOUT = act[0];   
						u32Reg_temp=inpw(u32Reg);
						if((u32Reg_temp & 0x10) == 0){ // 往左
							locx = locx - 8;
							DrvSYS_Delay(10000); //防彈跳
						}
						tGPIO_A->DOUT = act[2];   
						u32Reg_temp=inpw(u32Reg);
						if((u32Reg_temp & 0x10) == 0){ // 往右
							locx = locx + 8;
							DrvSYS_Delay(10000); //防彈跳
						}
						tGPIO_A->DOUT = act[1];   
						u32Reg_temp=inpw(u32Reg);
						if((u32Reg_temp & 0x10) == 0){ // 射擊
							if(locx == old_x+16){
								seg[2] = seg[2] ^ changeled[2];
								m = 2;
								delay = 1;
								while(d < 2){
									for(y = 3; y < 5; y++)
										for(x = locx - 13; x < locx; x++)
											draw(y,x,hey[y-3][x-(locx-13)]);
								}
								delay = 0;
								for(y = 0; y < 8; y++)
									for(x = 0; x < 128; x++)
										draw(y,x,0x00);
								delay = 1;
								while(d < 2){
									if(d < 2){
									for(y = 4; y < 6; y++)
										for(x = 0; x < 128; x++)
											draw(y,x,goodjob[y-4][x]);
									}
								}
								delay = 0;
								break;
							}
							DrvSYS_Delay(10000); //防彈跳
						}
					}
					else{
						drawgameover();
						break;
					}
					DrvSYS_Delay(50000);
				}
				delay = 1;
				while(d < 8){		
					for(y = 0; y < 8; y++)
						for(x = 0; x < 128; x++)
							draw(y, x, mission2[y][x]);
				}
				delay = 0;
				while(1){ // 任務2		
					if(pull == 0){
						press2 = 1;
						for(y = 0; y < 8; y++)
							for(x = 0; x < 128; x++)
								draw(y,x,background2[y][x]);
						for(y = 1; y < 5; y++)
							for(x = old_x2; x < old_x2 + 21; x++){
								if(old_x2 >= 40)
									draw(y, x, run[y-1][x-old_x2]);
								else{
									for(y = old_y2; y < old_y2 + 4; y++)
										for(x = old_x2; x < old_x2 + 21; x++)
										draw(y,x,run[y-old_y2][x-old_x2]);
								}
							}
					}
					for(x = locrope; x < locrope + 8; x++)
						draw(0, x, rope[x - locrope]);		
          for(x = 0; x < 80; x++){
						tGPIO_C->DOUT = 0xffff;
						tGPIO_C->DOUT = seg[3];
					  DrvSYS_Delay(1000);
						tGPIO_C->DOUT = 0xffff;
						tGPIO_C->DOUT = seg[2];
					  DrvSYS_Delay(1000);
					}					
					tGPIO_A->DOUT = act[0];   
					u32Reg_temp=inpw(u32Reg);
					if((u32Reg_temp & 0x10) == 0){ // 往左
							locrope = locrope - 8;
						DrvSYS_Delay(10000); //防彈跳
					}
					tGPIO_A->DOUT = act[2];   
					u32Reg_temp=inpw(u32Reg);
					if((u32Reg_temp & 0x10) == 0){ // 往右
						if(locrope < 120)
							locrope = locrope + 8;
						DrvSYS_Delay(10000); //防彈跳
					}
					tGPIO_A->DOUT = act[1];
					u32Reg_temp=inpw(u32Reg);
					if((u32Reg_temp & 0x20) == 0){ // 拋繩子
						for(x = locrope; x < locrope + 8; x++)
							draw(1, x, rope[x - locrope]);
						DrvSYS_Delay(100000);
						if(pull == 0)
							for(x = locrope; x < locrope + 8; x++)
								draw(2, x, rope[x - locrope]);
						DrvSYS_Delay(100000);
						if(locrope == old_x2){	// 救人
							seg[1] = seg[1] ^ changeled[1];
							m = 2;
							pull = 1;
							while(old_y2 > -4){
								if(old_y2 == 0){
									clearsavepeople(4);
									drawsavepeople(0);
								}
								if(old_y2 == -1){
									clearsavepeople(3);
									drawsavepeople(1);
								}
								if(old_y2 == -2){
									clearsavepeople(2);
									drawsavepeople(2);
								}
								if(old_y2 == -3){
									clearsavepeople(1);
									drawsavepeople(3);
								}
								for(x = 0; x < 70; x++){
									tGPIO_C->DOUT = 0xffff;
									tGPIO_C->DOUT = seg[3];
									DrvSYS_Delay(1000);
									tGPIO_C->DOUT = 0xffff;
									tGPIO_C->DOUT = seg[2];
									DrvSYS_Delay(1000);
					      }		
							}
							clearsavepeople(0);
							for(y = 0; y < 8; y++)
								for(x = 0; x < 128; x++)
									draw(y,x,0x00);
							break;
					  }
						DrvSYS_Delay(10000); //防彈跳
					}
					if(old_y2 == 4){
						drawgameover();
						break;
					}
					}
					delay = 1;
					while(d < 10){
						if(d == 0){
							for(y = 4; y < 6; y++)
								for(x = 0; x < 128; x++)
									draw(y,x,awesome[y-4][x]);
						}
						if(d > 1){
							for(y = 0; y < 8; y++)
								for(x = 0; x < 128; x++)
									draw(y, x, mission3[y][x]);
						}	
					}
					delay = 0;
				for(y = 0; y < 8; y++)
					for(x = 0; x < 128; x++)
						draw(y, x, 0x00);
				while(1) { // 任務3
					start = 1;
					if(old_y3 == 1)
						temp = rand;
					if(temp > 26){
						for(y = 0; y < 3; y++)
							for(x = temp - 26; x < temp; x++)
								draw(y,x,biggun[y][x-(temp-26)]);
					}
					for(y = 3; y < 8; y++)
						for(x = locx3; x < locx3 + 35; x++){
							if(side)
								draw(y,x,rworker[y-3][x-locx3]);
							else
								draw(y,x,lworker[y-3][x-locx3]);
						}	
					for(x = temp; x < temp + 8; x++){ //噴球
						draw(old_y3, x, ball[x-temp]);
						if(old_y3 > 1){
							draw(old_y3-1, x,0x00);
						}
						if(old_y3 == 7)
							draw(7,x,0x00);
					}		
				if(old_y3 == 7){ // 如果有接到
						if(side){
							if((temp >= locx3 + 20) && (temp + 8 <= locx3 + 32) && (old_y3 == 7)){
							old_y3 = 1;
								score++;m = 2;}
							}
						else{
							if((temp >= locx3 + 4) && (temp + 8 <= locx3 + 16) && (old_y3 == 7)){
							old_y3 = 1;
								score++;m = 2;}
							}
						if(score == 5)
							break;
						for(y = 3; y < 8; y++)
							for(x = locx3; x < locx3 + 35; x++){
								if(side)
									draw(y,x,rworker[y-3][x-locx3]);
								else
									draw(y,x,lworker[y-3][x-locx3]);
							}
							if(temp > 26)
								for(y = 0; y < 3; y++)
									for(x = temp - 26; x < temp; x++)
										draw(y,x,0x00);
					}
					for(x = 0; x < 20; x++){
						tGPIO_C->DOUT = 0xffff;
						tGPIO_C->DOUT = seg[3];
						tGPIO_E->DOUT = pattern[((60-gametime)/2)%10]; 
						DrvSYS_Delay(500);
						tGPIO_C->DOUT = 0xffff;
						tGPIO_C->DOUT = seg[2];
						tGPIO_E->DOUT = pattern[(60-gametime)/20]; 
						DrvSYS_Delay(500);
						tGPIO_C->DOUT = 0xffff;
						tGPIO_C->DOUT = 0xbf00;
					  DrvSYS_Delay(500);
						tGPIO_C->DOUT = 0xffff;
						tGPIO_C->DOUT =  seg[0];
						tGPIO_E->DOUT = pattern[5 - score]; 
						DrvSYS_Delay(500);
					}
					tGPIO_A->DOUT = act[0];   
					u32Reg_temp=inpw(u32Reg);
					if((u32Reg_temp & 0x10) == 0){ // 往左
						side = 0;
						for(y = 3; y < 8; y++)
							for(x = locx3; x < locx3 + 35; x++)
								draw(y,x,0x00);
						if(locx3 > 0)
							locx3 = locx3 - 8;
						DrvSYS_Delay(10000); //防彈跳
					}
					tGPIO_A->DOUT = act[2];   
					u32Reg_temp=inpw(u32Reg);
					if((u32Reg_temp & 0x10) == 0){ // 往右
						side = 1;
						for(y = 3; y < 8; y++)
							for(x = locx3; x < locx3 + 35; x++)
								draw(y,x,0x00);
						if(locx3 < 96)
							locx3 = locx3 + 8;
						DrvSYS_Delay(10000); //防彈跳
					}
					if(gametime == 60){
						drawgameover();
					}
				}
				delay = 1;
				while(d < 8){
					for(y = 0; y < 8; y++)
						for(x = 0; x < 128; x++)
							draw(y, x, mission4[y][x]);
				}
				delay = 0;
				for(y = 0; y < 8; y++)
					for(x = 0; x < 128; x++)
						draw(y, x, 0x00);
				while(1){ // 任務4
					final = 1;
					for(y = 4; y < 8; y++){
						for(x = lochero; x < lochero + 38; x++)
							draw(y,x,hero[y-4][x-lochero]);
						if(save == 0)
							for(x = lockiller; x < lockiller + 21; x++)
								draw(y,x,killer[y-4][x-lockiller]);
						for(x = locjj; x < locjj + 19; x++)
							draw(y,x,baggage[y-4][x-locjj]);
					}
					for(x = 0; x < 20; x++){
						tGPIO_C->DOUT = 0xffff;
						tGPIO_C->DOUT =  seg[3];
						tGPIO_E->DOUT = pattern[((10-savetime)/2)%10]; 
						DrvSYS_Delay(500);
						tGPIO_C->DOUT = 0xffff;
						tGPIO_C->DOUT =  0xdf00;
						DrvSYS_Delay(500);
						tGPIO_C->DOUT = 0xffff;
						tGPIO_C->DOUT =  0xbf00;
						DrvSYS_Delay(500);
						tGPIO_C->DOUT = 0xffff;
						tGPIO_C->DOUT =  0x7f00;;
						tGPIO_E->DOUT = pattern[((10-savetime)/2)%10]; 
						DrvSYS_Delay(500);
					}
					tGPIO_A->DOUT = act[0];   
					u32Reg_temp=inpw(u32Reg);
					if((u32Reg_temp & 0x10) == 0){ // 往左
						for(y = 4; y < 8; y++)
							for(x = lochero; x < lochero + 38; x++)
								draw(y,x,0x00);
						if(lochero < 32)
							lochero = lochero - 4;
						DrvSYS_Delay(100000); //防彈跳
					}
					tGPIO_A->DOUT = act[2];   
					u32Reg_temp=inpw(u32Reg);
					if((u32Reg_temp & 0x10) == 0){ // 往右
						for(y = 4; y < 8; y++)
							for(x = lochero; x < lochero + 38; x++)
								draw(y,x,0x00);
						if(lochero < 32)
							lochero = lochero + 4;
						DrvSYS_Delay(100000); //防彈跳
					}
					tGPIO_A->DOUT = act[1];
					u32Reg_temp=inpw(u32Reg);
					if((u32Reg_temp & 0x10) == 0){ // 攻擊
						if(lochero == 32){
							save = 1;
							for(y = 4; y < 8; y++){
								for(x = lockiller; x < lockiller + 21; x++)
									draw(y,x,0x00);
								for(x = lochero; x < lochero + 38; x++)
									draw(y,x,0x00);
								for(x = lochero + 8; x < lochero + 30; x++)
									draw(y,x,heroatt[y-4][x-(lochero+8)]);
							}
							while(savetime < 10){
								if(savetime == 9)						
									drawfinal();						
							}
						}
						DrvSYS_Delay(100000); //防彈跳
					}
					if(savetime == 10){
						for(y = 4; y < 8; y++)
							for(x = locjj; x < locjj + 19; x++)
								draw(y,x,0x00);
						while(savetime < 13){							
							for(y = 6; y < 8; y++)
								for(x = locjj; x < locjj+34; x++)
									draw(y,x,jjdie[y-6][x-locjj]);
						}
					}
					if(savetime == 13){
						drawgameover();
					}
				}
		  }
	}
}
